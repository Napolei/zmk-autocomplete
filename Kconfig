## Kconfig
```kconfig
config ZMK_AUTOCOMPLETE_HISTORY_SIZE
    int "Autocomplete history size"
    default 64
```

## dts/bindings/zmk,behavior-autocomplete.yaml
```yaml
description: Simple ZMK autocomplete behavior

compatible: "zmk,behavior-autocomplete"

include: zero_param.yaml

properties:
  max-delay-ms:
    type: int
    default: 1000

child-binding:
  properties:
    bindings:
      type: phandle-array
      required: true
```
